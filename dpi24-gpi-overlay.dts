/dts-v1/;
/plugin/;

/{
    compatible = "brcm,bcm2835", "allwinner,sun4i-a10", "allwinner,sun7i-a20", "allwinner,sun8i-h3", "allwinner,sun50i-a64", "allwinner,sun50i-h5", "sinovoip,bpi-m2-zero", "allwinner,sun8i-h2-plus";
    
    // There is no DPI driver module, but we need a platform device
    // node (that doesn't already use pinctrl) to hang the pinctrl
    // reference on - leds will do

    fragment@0 {
        target = <&leds>;
        __overlay__ {
            pinctrl-names = "default";
            pinctrl-0 = <&dpi24_pins>;
        };
    };

    fragment@1 {
        target = <&gpio>;
        __overlay__ {
            dpi24_pins: dpi24_pins {
                brcm,pins = <0 1 2 3 4 5 6 7 8 9 10 11
                             12 13 14 15 16 17 20
                             21 22 23 24 25 26 27>;
                brcm,function = <6>; /* alt2 */
                brcm,pull = <0>; /* no pull */
            };
        };
    };
};
